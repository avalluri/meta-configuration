## conf/layer.conf
```bitbake
BBPATH .= ":${LAYERDIR}"

BBFILES += "${LAYERDIR}/recipes*/*/*.bb ${LAYERDIR}/bbappend/*/*.bbappend"

BBFILE_COLLECTIONS += "conffw-layer"
BBFILE_PATTERN_conffw-layer := "^${LAYERDIR}/"
BBFILE_PRIORITY_conffw-layer = "8"

LAYERDEPENDS_conffw-layer = "core"

BBFILES_DYNAMIC += " \
    core:${LAYERDIR}/bbappends/openembedded-core/meta/*/*/*.bbappend \
"

CONFFW_LAYERDIR = '${@os.path.normpath("${LAYERDIR}")}'

USERADD_UID_TABLES += "conf/rpcd-passwd"
USERADD_GID_TABLES += "conf/rpcd-group"
```
